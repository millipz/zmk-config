## config/west.yml
```yaml
manifest:
  defaults:
    revision: v0.3
  remotes:
  - name: zmkfirmware
    url-base: https://github.com/zmkfirmware
    # Additional modules containing boards/shields/custom code can be listed here as well
    # See https://docs.zephyrproject.org/3.2.0/develop/west/manifest.html#projects
  projects:
  - name: zmk
    remote: zmkfirmware
    import: app/west.yml
  - name: keyboardio-preonic-zmk-config
    url: https://github.com/keyboardio/keyboardio-preonic-zmk-config
    revision: main
    path: modules/keyboardio-preonic-zmk-config
  self:
    path: config
```
